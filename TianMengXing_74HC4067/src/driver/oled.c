/**
 * @file    oled.c
 * @brief   SSD1306 OLED 128x64 驱动 (Bit-Banged I2C on PA2/PA3)
 *
 * 使用软件 I2C (bit-bang) 避免 SysConfig 依赖，简单可靠。
 * 32MHz CPU 时钟下轻松达到 400kHz I2C。
 */

#include "oled.h"
#include <string.h>
#include <stdio.h>
#include <stdlib.h>

/* ===== 帧缓冲区 ===== */
static uint8_t oled_buf[OLED_WIDTH * OLED_PAGES];

/* ===== 位绊 I2C GPIO ==== */
#define I2C_PORT    GPIOA
#define I2C_SCL_PIN DL_GPIO_PIN_31  /* PA31 */
#define I2C_SDA_PIN DL_GPIO_PIN_28  /* PA28 */

static void i2c_delay(void)
{
    /* ~2.5us for 400kHz I2C */
    delay_cycles(80);
}

static void i2c_scl_lo(void)
{
    DL_GPIO_clearPins(I2C_PORT, I2C_SCL_PIN);
    DL_GPIO_enableOutput(I2C_PORT, I2C_SCL_PIN);
}

static void i2c_scl_hi(void)
{
    DL_GPIO_disableOutput(I2C_PORT, I2C_SCL_PIN);
}

static void i2c_sda_lo(void)
{
    DL_GPIO_clearPins(I2C_PORT, I2C_SDA_PIN);
    DL_GPIO_enableOutput(I2C_PORT, I2C_SDA_PIN);
}

static void i2c_sda_hi(void)
{
    DL_GPIO_disableOutput(I2C_PORT, I2C_SDA_PIN);
}
static uint32_t i2c_sda_read(void) { return DL_GPIO_readPins(I2C_PORT, I2C_SDA_PIN); }

static void i2c_start(void)
{
    i2c_sda_hi();
    i2c_scl_hi();
    i2c_delay();
    i2c_sda_lo();
    i2c_delay();
    i2c_scl_lo();
}

static void i2c_stop(void)
{
    i2c_sda_lo();
    i2c_scl_hi();
    i2c_delay();
    i2c_sda_hi();
    i2c_delay();
}

static bool i2c_write_byte(uint8_t byte)
{
    for (uint8_t i = 0; i < 8; i++) {
        if (byte & 0x80) i2c_sda_hi();
        else             i2c_sda_lo();
        i2c_delay();
        i2c_scl_hi();
        i2c_delay();
        i2c_scl_lo();
        byte <<= 1;
    }
    /* ACK */
    i2c_sda_hi();
    i2c_scl_hi();
    i2c_delay();
    bool ack = (i2c_sda_read() == 0);
    i2c_scl_lo();
    return ack;
}

static void oled_write_cmd(uint8_t cmd)
{
    i2c_start();
    i2c_write_byte((OLED_I2C_ADDR << 1) | 0);  /* 写地址 */
    i2c_write_byte(0x00);                        /* 控制字节: 命令 */
    i2c_write_byte(cmd);
    i2c_stop();
}

static void oled_write_data_buf(const uint8_t *data, uint16_t len)
{
    i2c_start();
    i2c_write_byte((OLED_I2C_ADDR << 1) | 0);  /* 写地址 */
    i2c_write_byte(0x40);                        /* 控制字节: 数据 */
    while (len--) {
        i2c_write_byte(*data++);
    }
    i2c_stop();
}

/* ===== 6x8 字体 ===== */
static const uint8_t font6x8[][6] = {
    {0x00,0x00,0x00,0x00,0x00,0x00}, /* sp */
    {0x00,0x00,0x5F,0x00,0x00,0x00}, /* ! */
    {0x00,0x07,0x00,0x07,0x00,0x00}, /* " */
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    {0x08,0x08,0x2A,0x1C,0x08,0x00}, /* ~ */
};

static inline void oled_set_buf_px(uint8_t x, uint8_t y, bool on)
{
    if (x >= OLED_WIDTH || y >= OLED_HEIGHT) return;
    uint8_t page = y / 8;
    uint8_t bit  = y % 8;
    if (on) oled_buf[page * OLED_WIDTH + x] |=  (1 << bit);
    else    oled_buf[page * OLED_WIDTH + x] &= ~(1 << bit);
}

void oled_init(void)
{
    /* GPIO 初始化：PA2/PA3 开漏输出, 初始高电平 */
    DL_GPIO_initDigitalInputFeatures(
        OLED_I2C_SCL_PINCM, DL_GPIO_INVERSION_DISABLE,
        DL_GPIO_RESISTOR_PULL_UP, DL_GPIO_HYSTERESIS_DISABLE,
        DL_GPIO_WAKEUP_DISABLE);
    DL_GPIO_initDigitalInputFeatures(
        OLED_I2C_SDA_PINCM, DL_GPIO_INVERSION_DISABLE,
        DL_GPIO_RESISTOR_PULL_UP, DL_GPIO_HYSTERESIS_DISABLE,
        DL_GPIO_WAKEUP_DISABLE);
    DL_GPIO_clearPins(I2C_PORT, I2C_SCL_PIN | I2C_SDA_PIN);
    i2c_scl_hi();
    i2c_sda_hi();
    delay_cycles(3100000U);

    delay_cycles(100000);  /* 等 OLED 上电 >100ms */

    /* SSD1306 初始化序列 */
    oled_write_cmd(0xAE);  /* 关显示 */
    oled_write_cmd(0xD5);  /* 时钟分频 */
    oled_write_cmd(0x80);
    oled_write_cmd(0xA8);  /* MUX */
    oled_write_cmd(0x3F);  /* 64 */
    oled_write_cmd(0xD3);  /* 偏移 */
    oled_write_cmd(0x00);
    oled_write_cmd(0x40);  /* 起始行 */
    oled_write_cmd(0x8D);  /* 电荷泵 */
    oled_write_cmd(0x14);
    oled_write_cmd(0x20);  /* 寻址模式 */
    oled_write_cmd(0x00);  /* 水平 */
    oled_write_cmd(0xA1);  /* 段重映射 */
    oled_write_cmd(0xC8);  /* COM 扫描 */
    oled_write_cmd(0xDA);  /* COM 引脚 */
    oled_write_cmd(0x12);
    oled_write_cmd(0x81);  /* 对比度 */
    oled_write_cmd(0xCF);
    oled_write_cmd(0xD9);  /* 预充电 */
    oled_write_cmd(0xF1);
    oled_write_cmd(0xDB);  /* VCOMH */
    oled_write_cmd(0x40);
    oled_write_cmd(0xA4);  /* 全屏显示 off */
    oled_write_cmd(0xA6);  /* 正常显示 */
    oled_write_cmd(0x2E);  /* 停滚动 */
    oled_write_cmd(0xAF);  /* 开显示 */

    oled_clear();
    oled_update();
}

void oled_clear(void)
{
    memset(oled_buf, 0, sizeof(oled_buf));
}

void oled_update(void)
{
    for (uint8_t page = 0; page < OLED_PAGES; page++) {
        oled_write_cmd(0xB0 + page);
        oled_write_cmd(0x00);  /* 列低 */
        oled_write_cmd(0x10);  /* 列高 */
        oled_write_data_buf(&oled_buf[page * OLED_WIDTH], OLED_WIDTH);
    }
}

void oled_update_page(uint8_t page)
{
    if (page >= OLED_PAGES) {
        return;
    }
    oled_write_cmd(0xB0 + page);
    oled_write_cmd(0x00);
    oled_write_cmd(0x10);
    oled_write_data_buf(&oled_buf[page * OLED_WIDTH], OLED_WIDTH);
}

void oled_string(uint8_t x, uint8_t page, const char *str)
{
    while (*str && x < OLED_WIDTH) {
        char c = *str;
        if (c < 32 || c > 127) c = ' ';
        const uint8_t *g = font6x8[c - 32];
        for (uint8_t col = 0; col < 6 && (x + col) < OLED_WIDTH; col++) {
            oled_buf[page * OLED_WIDTH + x + col] = g[col];
        }
        x += 6;
        str++;
    }
}

void oled_pixel(uint8_t x, uint8_t y, bool on)
{
    oled_set_buf_px(x, y, on);
}

void oled_hline(uint8_t x, uint8_t y, uint8_t w)
{
    for (uint8_t i = 0; i < w && (x + i) < OLED_WIDTH; i++) {
        oled_set_buf_px(x + i, y, true);
    }
}

void oled_vline(uint8_t x, uint8_t y, uint8_t h)
{
    for (uint8_t i = 0; i < h && (y + i) < OLED_HEIGHT; i++) {
        oled_set_buf_px(x, y + i, true);
    }
}

void oled_fill_rect(uint8_t x, uint8_t y, uint8_t w, uint8_t h, bool on)
{
    for (uint8_t i = 0; i < w; i++) {
        for (uint8_t j = 0; j < h; j++) {
            oled_set_buf_px(x + i, y + j, on);
        }
    }
}

void oled_big_number(int16_t n, uint8_t x, uint8_t page)
{
    char buf[8];
    snprintf(buf, sizeof(buf), "%d", n);
    oled_string(x, page, buf);
}

void oled_display_status(const char *task, int16_t ball_pos, int16_t target,
                         int16_t speed, uint32_t lap_time_ms)
{
    oled_clear();

    if (task) oled_string(0, 0, task);

    {
        char buf[22];
        uint32_t sec = lap_time_ms / 1000;
        uint32_t ms  = lap_time_ms % 1000;
        snprintf(buf, sizeof(buf), "Lap:%lu.%03lu", (unsigned long)sec, (unsigned long)ms);
        oled_string(0, 1, buf);
    }

    {
        char buf[22];
        snprintf(buf, sizeof(buf), "Ball:%+5d", ball_pos);
        oled_string(0, 2, buf);
    }

    {
        char buf[22];
        snprintf(buf, sizeof(buf), "Tgt: %+5d", target);
        oled_string(0, 4, buf);
    }

    {
        char buf[22];
        snprintf(buf, sizeof(buf), "Spd:%+4d", speed);
        oled_string(0, 6, buf);
        uint8_t bar_w = (uint8_t)((abs(speed) * 60) / 1000);  /* max speed = 1000 */
        if (bar_w > 0) oled_fill_rect(60, 48, bar_w, 16, true);
    }
}
