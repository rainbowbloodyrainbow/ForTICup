/**
 * Tianmengxing MSPM0G3507 project configuration.
 *
 * Open this file with the "Open TI SysConfig" VS Code task, then add the
 * clocks, pins, and peripherals required by the application.
 */
//@cliArgs --device "MSPM0G350X" --package "LQFP-64(PM)" --part "Default"
//@v2CliArgs --device "MSPM0G3507" --package "LQFP-64(PM)"

const SYSCTL = scripting.addModule("/ti/driverlib/SYSCTL");
const Board  = scripting.addModule("/ti/driverlib/Board", {}, false);

SYSCTL.forceDefaultClkConfig = true;
SYSCTL.clockTreeEn = true;
